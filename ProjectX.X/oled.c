/**
 * oled.c
 * SSD1306 128x64 OLED Driver (4-wire Software SPI)
 * Target: PIC24EP128GP202 (MPLAB X / XC16)
 *
 * Uses bit-bang SPI so it works regardless of whether MCC SPI is
 * configured for 8-bit or 16-bit mode.
 *
 * Wiring:
 *   CS  -> RB0  | SCK -> RB7 | SDA -> RB8 | DC -> RB10 | RST -> RA0
 */

#include "oled.h"
#include "mcc_generated_files/pin_manager.h"
#include <stddef.h>

/* ------------------------------------------------------------------ */
/*  5x8 ASCII font, characters 0x20 (' ') through 0x7E ('~')          */
/*  Each character is 5 bytes wide, 8 pixels tall (1 page row).        */
/* ------------------------------------------------------------------ */
static const uint8_t font5x8[][5] = {
    {0x00,0x00,0x00,0x00,0x00}, /* 0x20  space  */
    {0x00,0x00,0x5F,0x00,0x00}, /* 0x21  !      */
    {0x00,0x07,0x00,0x07,0x00}, /* 0x22  "      */
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    {0x10,0x08,0x08,0x10,0x08}, /* 0x7E  ~      */
};

#define FONT_FIRST_CHAR  0x20
#define FONT_CHAR_WIDTH  5
#define FONT_CHAR_SPACING 1   // 1 blank column between characters

/* ------------------------------------------------------------------ */
/*  Software (bit-bang) SPI                                            */
/* ------------------------------------------------------------------ */

/* Tiny delay — tune if needed for your Fosc */
static void _delay_us(uint16_t us) {
    uint16_t i, j;
    for (i = 0; i < us; i++)
        for (j = 0; j < 4; j++)
            Nop();
}

/**
 * Send one byte MSB-first over software SPI.
 * CS must be asserted (low) by the caller before invoking this.
 */
static void SPI_SendByte(uint8_t byte) {
    uint8_t i;
    for (i = 0; i < 8; i++) {
        SCK1_SetLow();
        if (byte & 0x80)
            SDO1_SetHigh();
        else
            SDO1_SetLow();
        byte <<= 1;
        _delay_us(1);
        SCK1_SetHigh();
        _delay_us(1);
    }
    SCK1_SetLow();
}

/* ------------------------------------------------------------------ */
/*  Low-level OLED command / data helpers                              */
/* ------------------------------------------------------------------ */

static void OLED_SendCommand(uint8_t cmd) {
    IO_RB10_SetLow();   /* DC = 0 -> Command */
    SS1_SetLow();       /* CS = 0 -> select  */
    SPI_SendByte(cmd);
    SS1_SetHigh();      /* CS = 1 -> deselect */
}

static void OLED_SendData(uint8_t data) {
    IO_RB10_SetHigh();  /* DC = 1 -> Data    */
    SS1_SetLow();       /* CS = 0 -> select  */
    SPI_SendByte(data);
    SS1_SetHigh();      /* CS = 1 -> deselect */
}

/* Set cursor to (page, col) in page-addressing mode */
static void OLED_SetCursor(uint8_t page, uint8_t col) {
    OLED_SendCommand(0xB0 | (page & 0x07));          /* page address  */
    OLED_SendCommand(0x00 | (col & 0x0F));           /* col low nibble  */
    OLED_SendCommand(0x10 | ((col >> 4) & 0x0F));   /* col high nibble */
}

/* ------------------------------------------------------------------ */
/*  Public API                                                         */
/* ------------------------------------------------------------------ */

/**
 * OLED_Init
 * Hardware-reset the display then send the SSD1306 init sequence.
 * Call once after SYSTEM_Initialize().
 */
void OLED_Init(void) {
    /* ------ Force control pins to digital outputs ------
     * MCC leaves RB0 (SS1/CS) as an INPUT (TRISB bit 0 = 1).
     * SPI1 was also configured with DISSDO+DISSCK, so SCK/MOSI
     * are already free GPIOs — but CS must be fixed here.        */
    SS1_SetDigitalOutput();     /* RB0  -> output (CS)  */
    IO_RB10_SetDigitalOutput(); /* RB10 -> output (DC)  */
    IO_RA0_SetDigitalOutput();  /* RA0  -> output (RST) */
    SCK1_SetDigitalOutput();    /* RB7  -> output (SCK) */
    SDO1_SetDigitalOutput();    /* RB8  -> output (MOSI)*/

    /* Safe idle states */
    SS1_SetHigh();    /* CS  deasserted */
    SCK1_SetLow();    /* SCK idle low   */
    IO_RB10_SetLow(); /* DC default low */

    /* ------ Hardware reset ------ */
    IO_RA0_SetHigh();   /* RST = 1 */
    _delay_us(1000);
    IO_RA0_SetLow();    /* RST = 0 (assert reset) */
    _delay_us(10000);
    IO_RA0_SetHigh();   /* RST = 1 (release reset) */
    _delay_us(1000);

    /* ------ SSD1306 initialisation sequence ------ */
    OLED_SendCommand(0xAE); /* Display OFF                         */
    OLED_SendCommand(0xD5); /* Set display clock divide ratio      */
    OLED_SendCommand(0x80); /*   ratio = 1, osc freq = mid         */
    OLED_SendCommand(0xA8); /* Set multiplex ratio                 */
    OLED_SendCommand(0x3F); /*   64MUX                             */
    OLED_SendCommand(0xD3); /* Set display offset                  */
    OLED_SendCommand(0x00); /*   no offset                         */
    OLED_SendCommand(0x40); /* Set display start line = 0          */
    OLED_SendCommand(0x8D); /* Charge pump setting                 */
    OLED_SendCommand(0x14); /*   enable charge pump                */
    OLED_SendCommand(0x20); /* Set memory addressing mode          */
    OLED_SendCommand(0x02); /*   page addressing mode              */
    OLED_SendCommand(0xA1); /* Set segment re-map (col 127 = SEG0) */
    OLED_SendCommand(0xC8); /* COM output scan direction (remapped)*/
    OLED_SendCommand(0xDA); /* Set COM pins hardware config        */
    OLED_SendCommand(0x12); /*   alternative, disable L/R remap   */
    OLED_SendCommand(0x81); /* Set contrast                        */
    OLED_SendCommand(0xCF); /*   high contrast                     */
    OLED_SendCommand(0xD9); /* Set pre-charge period               */
    OLED_SendCommand(0xF1);
    OLED_SendCommand(0xDB); /* Set VCOMH deselect level            */
    OLED_SendCommand(0x40);
    OLED_SendCommand(0xA4); /* Entire display ON (follow RAM)      */
    OLED_SendCommand(0xA6); /* Normal (non-inverted) display       */
    OLED_SendCommand(0xAF); /* Display ON                          */
}

/**
 * OLED_Clear
 * Write 0x00 to every byte in the 128x8-page frame buffer.
 */
void OLED_Clear(void) {
    uint8_t page, col;
    for (page = 0; page < OLED_PAGES; page++) {
        OLED_SetCursor(page, 0);
        for (col = 0; col < OLED_WIDTH; col++) {
            OLED_SendData(0x00);
        }
    }
}

/**
 * OLED_DrawChar
 * Render a single ASCII character at (page, col).
 * Occupies 6 columns: 5 font pixels + 1 blank spacer.
 */
void OLED_DrawChar(uint8_t page, uint8_t col, char c) {
    uint8_t i;
    const uint8_t *glyph;

    if (c < FONT_FIRST_CHAR || c > 0x7E)
        c = ' ';

    glyph = font5x8[(uint8_t)(c - FONT_FIRST_CHAR)];

    OLED_SetCursor(page, col);
    for (i = 0; i < FONT_CHAR_WIDTH; i++) {
        OLED_SendData(glyph[i]);
    }
    OLED_SendData(0x00); /* spacing column */
}

/**
 * OLED_DrawString
 * Render a null-terminated string starting at (page, col).
 * Characters wrap to the same page if they exceed 128 columns.
 */
void OLED_DrawString(uint8_t page, uint8_t col, const char *str) {
    while (*str) {
        if (col + FONT_CHAR_WIDTH + FONT_CHAR_SPACING > OLED_WIDTH)
            break; /* stop at right edge */
        OLED_DrawChar(page, col, *str++);
        col += FONT_CHAR_WIDTH + FONT_CHAR_SPACING;
    }
}
